## ncs/nordic/drivers/Kconfig
```kconfig
# drivers configuration options

# Copyright (c) 2015 Intel Corporation
# SPDX-License-Identifier: Apache-2.0

menu "Hallows Device Drivers"

# zephyr-keep-sorted-start
rsource "input/Kconfig"
# zephyr-keep-sorted-stop

endmenu
```

## ncs/nordic/drivers/input/Kconfig
```kconfig
# Copyright (c) 2026 Daniel Veilleux
# SPDX-License-Identifier: Apache-2.0

menuconfig SNES_GAMEPAD
	bool "SNES gamepad device driver"
	depends on DT_HAS_DMV_SNES_GAMEPAD_ENABLED
	default y
	select GPIO
	help
	  This option enables the SNES gamepad driver.

if SNES_GAMEPAD

module = SNES_GAMEPAD
module-str = snes_gamepad
source "subsys/logging/Kconfig.template.log_config"

endif # SNES_GAMEPAD
```

## ncs/nordic/dts/bindings/input/snes-gamepad.yaml
```yaml
# Copyright (c) 2026, Daniel Veilleux
# SPDX-License-Identifier: Apache-2.0

description: |
  Use three GPIOs to read the original SNES shift-register-based gamepad.

  The original button names and ordering are maintained.

compatible: "dmv,snes-gamepad"

include: base.yaml

properties:
  polling-interval-ms:
    type: int
    default: 20
    description: |
       Polling interval time in milliseconds

  latch-gpios:
    type: phandle-array
    required: true
    description: Latch pin (output). The flags are overridden in the driver
      but must be set to 0 in the DT.

  data-gpios:
    type: phandle-array
    required: true
    description: Data pin (input). The flags are overridden in the driver
      but must be set to 0 in the DT.

  clock-gpios:
    type: phandle-array
    required: true
    description: Clock pin (output). The flags are overridden in the driver
      but must be set to 0 in the DT.
```

## ncs/nordic/subsys/bluetooth/services/Kconfig
```kconfig
#
# Copyright (c) 2019 Nordic Semiconductor ASA
#
# SPDX-License-Identifier: LicenseRef-Nordic-5-Clause
#

menu "Bluetooth Services"
rsource "Kconfig.hallows"
rsource "Kconfig.hallows_c"
endmenu
```

## ncs/nordic/subsys/bluetooth/services/Kconfig.hallows
```kconfig
config BT_HALLOWS
	bool "Hallows service"
	help
	 Enable GATT Hallows BLE service

if BT_HALLOWS

module = BT_HALLOWS
module-str = HALLOWS
source "${ZEPHYR_BASE}/subsys/logging/Kconfig.template.log_config"

endif # BT_HALLOWS
```

## ncs/nordic/subsys/bluetooth/services/Kconfig.hallows_c
```kconfig
config BT_HALLOWS_CLIENT
	bool "Hallows service client"
	select BT_GATT_DM
	select BT_GATT_CLIENT
	help
	 Enable GATT Hallows client

if BT_HALLOWS_CLIENT

module = BT_HALLOWS_CLIENT
module-str = Hallows Client
source "${ZEPHYR_BASE}/subsys/logging/Kconfig.template.log_config"

endif # BT_HALLOWS_CLIENT
```
